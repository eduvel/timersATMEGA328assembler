;
; Timers.asm
; En este proyecto se encuentra el codigo correspondiente a funcionamiento de TIMER1
; en modo NORMAL con POLLING e INTERRUPCIÓN
; en modo CTC con POLLING e INTERRUPCIÓN
; Estan escritos los cuatro codigos, decomentar el #define del codigo a compilar y comentar los demas #define
; 
;
#define INTERRUPCION_MODO_CTC

#ifdef	INTERRUPCION_MODO_CTC
		.ORG	0X0000
		JMP		INICIO
		.ORG	0X0016
		JMP		ISR_COMP1A
INICIO:
		LDI		R16,HIGH(RAMEND)
		OUT		SPH,R16
		LDI		R16,LOW(RAMEND)
		OUT		SPL,R16

		LDI		R16,(1<<DDB5) 
		OUT		DDRB,R16
		
		;Inicio configuración timer 1
		LDI		R16,0
		STS		TCCR1A,R16
		LDI		R16,(1<<WGM12)|(1<<CS12)
		STS		TCCR1B,R16
		LDI		R16,0
		STS		TCCR1C,R16
		LDI		R16,(1<<OCIE1A)
		STS		TIMSK1,R16
		LDI		R16,HIGH(31250)
		STS		OCR1AH,R16
		LDI		R16,LOW(31250)
		STS		OCR1AL,R16
		;Fin configuración timer 1
		SEI
VOLVER:
		RJMP	VOLVER

ISR_COMP1A:
		PUSH	R17
		IN		R17,SREG
		PUSH	R17

		SBI		PINB,PINB5
		
		POP		R17
		OUT		SREG,R17
		POP		R17
		RETI
#endif

;#define PULLING_MODO_CTC
#ifdef	PULLING_MODO_CTC
		.ORG	0X0000
		JMP		INICIO
INICIO:
		LDI		R16,HIGH(RAMEND)
		OUT		SPH,R16
		LDI		R16,LOW(RAMEND)
		OUT		SPL,R16

		LDI		R16,(1<<DDB5) 
		OUT		DDRB,R16
		
		;Inicio configuración timer 1
		LDI		R16,0
		STS		TCCR1A,R16
		LDI		R16,(1<<WGM12)|(1<<CS12)
		STS		TCCR1B,R16
		LDI		R16,0
		STS		TCCR1C,R16
		LDI		R16,0
		STS		TIMSK1,R16
		LDI		R16,HIGH(31250)
		STS		OCR1AH,R16
		LDI		R16,LOW(31250)
		STS		OCR1AL,R16
		;Fin configuración timer 1
		SEI
VOLVER:
		SBI		PORTB,PORTB5
		CALL	RETARDO1S
		CBI		PORTB,PORTB5
		CALL	RETARDO1S
		RJMP	VOLVER

RETARDO1S:
		SBIS	TIFR1,OCF1A
		RJMP	RETARDO1S
		SBI		TIFR1,OCF1A
		RET
#endif

;#define PULLING_MODO_NORMAL

#ifdef	PULLING_MODO_NORMAL
		.ORG	0X0000
		JMP		INICIO
INICIO:
		LDI		R16,HIGH(RAMEND)
		OUT		SPH,R16
		LDI		R16,LOW(RAMEND)
		OUT		SPL,R16

		LDI		R16,(1<<DDB5) 
		OUT		DDRB,R16
		
		;Inicio configuración timer 1
		LDI		R16,0
		STS		TCCR1A,R16
		LDI		R16,(1<<CS12)
		STS		TCCR1B,R16
		LDI		R16,0
		STS		TCCR1C,R16
		LDI		R16,0
		STS		TIMSK1,R16
		LDI		R16,HIGH(34286)
		STS		TCNT1H,R16
		LDI		R16,LOW(34286)
		STS		TCNT1L,R16
		;Fin configuración timer 1
		SEI
VOLVER:
		SBI		PORTB,PORTB5
		CALL	RETARDO1S
		CBI		PORTB,PORTB5
		CALL	RETARDO1S
		RJMP	VOLVER

RETARDO1S:
		SBIS	TIFR1,TOV1
		RJMP	RETARDO1S
		SBI		TIFR1,TOV1
		LDI		R16,HIGH(34286)
		STS		TCNT1H,R16
		LDI		R16,LOW(34286)
		STS		TCNT1L,R16
		RET
#endif
;#define INTERRUPCION_MODO_NORMAL

#ifdef	INTERRUPCION_MODO_NORMAL
		.ORG	0X0000
		JMP		INICIO
		.ORG	0X001A
		JMP		ISR_TOV1
INICIO:
		LDI		R16,HIGH(RAMEND)
		OUT		SPH,R16
		LDI		R16,LOW(RAMEND)
		OUT		SPL,R16

		LDI		R16,(1<<DDB5) 
		OUT		DDRB,R16
		
		;Inicio configuración timer 1
		LDI		R16,0
		STS		TCCR1A,R16
		LDI		R16,(1<<CS12)
		STS		TCCR1B,R16
		LDI		R16,0
		STS		TCCR1C,R16
		LDI		R16,(1<<TOIE1)
		STS		TIMSK1,R16
		LDI		R16,HIGH(34286)
		STS		TCNT1H,R16
		LDI		R16,LOW(34286)
		STS		TCNT1L,R16
		;Fin configuración timer 1
		SEI
VOLVER:
		RJMP	VOLVER

ISR_TOV1:
		PUSH	R17
		IN		R17,SREG
		PUSH	R17

		SBI		PINB,PINB5
		
		LDI		R16,HIGH(34286)
		STS		TCNT1H,R16
		LDI		R16,LOW(34286)
		STS		TCNT1L,R16

		POP		R17
		OUT		SREG,R17
		POP		R17
		RETI
#endif





		


